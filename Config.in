## scripts/kconfig
```kconfig
#!/bin/bash
# Minimal Kconfig operations for the debian-live SDK.
#
# Usage: ./scripts/kconfig <defconfig|oldconfig> [--help]
#
#   defconfig  copy .config.default over .config
#   oldconfig  add symbols missing from .config (from .config.default),
#              leaving existing values untouched

source "$(dirname "$0")/common.sh"
[[ "${1:-}" == "--help" || "${1:-}" == "-h" ]] && usage

cd "$PROJECT_DIR"
[[ -f .config.default ]] || die ".config.default missing"

sym_of() { # line -> CONFIG_NAME (for assignments and "# X is not set")
    local line="$1" name=""
    if [[ "$line" =~ ^(CONFIG_[A-Za-z0-9_]+)= ]]; then name="${BASH_REMATCH[1]}"; fi
    if [[ "$line" =~ ^#[[:space:]]*(CONFIG_[A-Za-z0-9_]+)[[:space:]]+is[[:space:]]+not[[:space:]]+set ]]; then
        name="${BASH_REMATCH[1]}"
    fi
    printf '%s' "$name"
}

case "${1:-}" in
    defconfig)
        cp .config.default .config
        ok ".config reset to defaults (make menuconfig to customize)"
        ;;
    oldconfig)
        [[ -f .config ]] || { cp .config.default .config; ok ".config created from defaults"; exit 0; }
        added=0
        while IFS= read -r line || [[ -n "$line" ]]; do
            name="$(sym_of "$line")"
            [[ -z "$name" ]] && continue
            if ! grep -qE "^(# ?$name is not set|$name=)" .config; then
                echo "$line" >> .config
                added=$((added + 1))
                log "oldconfig: added $name"
            fi
        done < .config.default
        ok "oldconfig done ($added symbol(s) added)"
        ;;
    *) die "usage: scripts/kconfig <defconfig|oldconfig>" ;;
esac
```
